## firmware/main/Kconfig.projbuild
```kconfig
menu "kiss-tnc-bridge"

    choice KTB_BOARD
        prompt "Board"
        default KTB_BOARD_ATOM_LITE
        help
            The board this firmware is built for. Each board's
            sdkconfig.<board> file picks one; board.h holds its pins.

        config KTB_BOARD_ATOM_LITE
            bool "M5Stack ATOM Lite"
        config KTB_BOARD_STICKC_PLUS_SE
            bool "M5Stack StickC Plus SE"
        config KTB_BOARD_CORE2
            bool "M5Stack Core2 v1.3"
    endchoice

    config KTB_DEBUG_COMMANDS
        bool "debug.* commands on USB serial"
        default n
        help
            Adds debug.set, debug.frame and debug.pairing_result to the
            control API, which fake the radio, phones and errors so the LED
            and gestures can be tried without them. For development builds
            only (sdkconfig.dev); release builds leave this off.

endmenu
```

## spikes/atom-lite-ble-tnc/main/Kconfig.projbuild
```kconfig
menu "ATOM Lite BLE TNC spike"

    config SPIKE_RADIO_ADDR
        string "TD-H9 Bluetooth address"
        default ""
        help
            Connect to this address at start. Empty: search for the first
            TD-H9 by name, as a double press would.

    config SPIKE_CLASSIC_INQUIRY
        bool "Run a Classic inquiry during the search"
        default y
        help
            A double press also looks for a TH-D74 or TH-D75 over Classic,
            so the BLE scan has to find a TD-H9 while an inquiry runs.

    config SPIKE_SEARCH_SECONDS
        int "How long a search runs"
        default 60

    config SPIKE_CALLSIGN
        string "Callsign for the test beacon"
        default "K0TFU-7"

    config SPIKE_REPORT_INTERVAL_S
        int "Seconds between status lines"
        default 10

endmenu
```

## spikes/atom-lite-memory/main/Kconfig.projbuild
```kconfig
menu "ATOM Lite memory spike"

    config SPIKE_RADIO_ADDR
        string "Radio Bluetooth address"
        default "40:79:12:E4:95:9D"
        help
            The TH-D74/D75 to connect to over SPP. The default is the dev TH-D75.

    config SPIKE_DEVICE_NAME
        string "Device name"
        default "KTB ATOM spike"
        help
            Classic name (what the radio shows when pairing) and BLE
            advertised name.

    config SPIKE_NO_SNIFF
        bool "Keep the radio link out of sniff mode"
        default y
        help
            Bluedroid parks an idle SPP link in sniff mode (500 ms interval)
            to save power. With this on, sniff is cleared from the radio
            link's policy as soon as SPP opens, so the link stays active.
            The TH-D75 sometimes doesn't answer a sniff exit, and the link
            then drops (see README.md), so this is on by default.

    config SPIKE_REPORT_INTERVAL_S
        int "Seconds between heap reports"
        default 10

    config SPIKE_MGMT_MAX_MESSAGE
        int "Largest management message, bytes"
        default 4096
        help
            Each BLE connection reserves a reassembly buffer of this size,
            as the real management service would.

endmenu
```

## spikes/atom-lite-update/main/Kconfig.projbuild
```kconfig
menu "ATOM Lite update spike"

    config SPIKE_RADIO_ADDR
        string "Radio Bluetooth address"
        default "40:79:12:E4:95:9D"
        help
            The TH-D74/D75 to connect to over SPP. The default is the dev TH-D75.

    config SPIKE_DEVICE_NAME
        string "Device name"
        default "KTB ATOM spike"
        help
            Classic name (what the radio shows when pairing) and BLE
            advertised name.

    config SPIKE_NO_SNIFF
        bool "Keep the radio link out of sniff mode"
        default y
        help
            The TH-D75 sometimes doesn't answer a sniff exit, and the link
            then drops (see the atom-lite-memory spike), so this is on.

    config SPIKE_REPORT_INTERVAL_S
        int "Seconds between heap reports"
        default 10

    config SPIKE_MGMT_MAX_MESSAGE
        int "Largest management message, bytes"
        default 4096

    config SPIKE_UPDATE_BUFFER
        int "Update receive buffer, bytes"
        default 24576
        help
            Image chunks wait here between the GATT callback and the task
            that writes them to flash. The client's window has to fit.

    config SPIKE_UPDATE_ACK_EVERY
        int "Acknowledge every N bytes written"
        default 4096

    config SPIKE_BREAK_SELF_TEST
        bool "Fail the self-test on purpose"
        default n
        help
            An image built with this crashes on its first boot instead of
            marking itself valid, so the bootloader should roll back to the
            previous app. For the rollback test only.

endmenu
```

## spikes/stickc-plus-se/main/Kconfig.projbuild
```kconfig
menu "StickC Plus SE spike"
config SPIKE_LVGL
    bool "Draw a status screen with LVGL instead of the colour tests"
    default n
endmenu
```
